## config/west.yml
```yaml
manifest:
  remotes:
    - name: zmkfirmware
      url-base: https://github.com/zmkfirmware
    - name: infused-kim
      url-base: https://github.com/infused-kim
    - name: hartblanc
      url-base: https://github.com/hartblanc
      
  projects:
    - name: zmk
      remote: hartblanc
      revision: sofle
      import: app/west.yml
  self:
    path: config
```
